## drivers/net/wireless/esp8089/Kconfig
```kconfig
config ESP8089
	tristate "esp8089 wireless support"
	depends on MAC80211
	---help---
	  This is a driver for the esp8089 wireless
	  chip module.
```
